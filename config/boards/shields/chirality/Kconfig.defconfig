## config/boards/shields/chirality/Kconfig.defconfig
```kconfig
if SHIELD_CHIRALITY_LEFT
config ZMK_SPLIT_ROLE_CENTRAL
	default y
endif

if SHIELD_CHIRALITY_RIGHT
config ZMK_SPLIT_ROLE_CENTRAL
    default n
endif

if SHIELD_CHIRALITY_LEFT || SHIELD_CHIRALITY_RIGHT

config ZMK_KEYBOARD_NAME
    default "Chirality"

config ZMK_SPLIT
    default y

config ZMK_DISPLAY
    default y

config ZMK_RGB_UNDERGLOW
    default y

config ZMK_RGB_UNDERGLOW_EXT_POWER
    default y

config BT
    default y

config ZMK_BLE
    default y

config EC11
    default y

config ZMK_SLEEP
    default y

config SETTINGS
    default y

config FLASH
    default y

config NVS
    default y

endif
```
